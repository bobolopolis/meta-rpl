## conf/layer.conf
```bitbake
# We have a conf and classes directory, add to BBPATH
BBPATH .= ":${LAYERDIR}"

# We have recipes-* directories, add to BBFILES
BBFILES += "${LAYERDIR}/recipes-*/*/*.bb \
            ${LAYERDIR}/recipes-*/*/*.bbappend"

BBFILE_COLLECTIONS += "meta-rpl"
BBFILE_PATTERN_meta-pios = "^${LAYERDIR}/"
BBFILE_PRIORITY_meta-pios = "6"

LAYERDEPENDS_meta-pios = "core"
LAYERSERIES_COMPAT_meta-pios = "dunfell"
```
